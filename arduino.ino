#include <Arduino.h>
#include <U8g2lib.h>
#include <Wire.h>
#include <Keyboard.h>
#include <SoftwareSerial.h>
#include <EEPROM.h>


// Khai báo chân nút bấm
const int buttonPins[4] = {4, 5, 6, 7};
// Mapping phím tương ứng

char osukeys[5][4] = {
	{KEY_ESC, '`', 'z', 'x'}, // osu std
	{KEY_ESC, 'z', 'c', 'x'}, // osu std # 2
	{'z', 'x', 'c', 'v'}, // osu mania + osu taiko
	{'z', 'x', 'c', 'v'},
	{KEY_ESC, KEY_LEFT_SHIFT, KEY_LEFT_ARROW, KEY_RIGHT_ARROW} // osu catch
};
// Biến lưu trạng thái
bool buttonState[4] = {0, 0, 0, 0};

bool configState = false;
bool updateScreen = true;

// Khởi tạo giao tiếp I2C mềm trên chân 7 và 6
// SoftWire softI2C(7, 6);

// Khai báo đối tượng U8g2
// U8G2_SSD1306_128X64_NONAME_F_SW_I2C u8g2(U8G2_R0, /* clock=*/ 6, /* data=*/ 7, /* reset=*/ U8X8_PIN_NONE);
// U8G2_R0: Hướng hiển thị màn hình (Rotate 0)
// SSD1306_128X64: Tên màn hình và kích thước
// NONAME: Không cần tên, thường dùng cho màn hình có địa chỉ I2C
// F: Sử dụng chế độ bộ đệm đầy đủ (full buffer)
// SW_I2C: Giao tiếp I2C phần mềm (Software I2C)
// Pin đồng hồ (SCL) là 6, Pin dữ liệu (SDA) là 7
// Pin reset không sử dụng nên đặt là U8X8_PIN_NONE
U8G2_SSD1306_128X64_NONAME_F_HW_I2C u8g2(U8G2_R0, U8X8_PIN_NONE);


// 'dm_emiko', 128x64px
const unsigned char myBitmapdm_emiko [] PROGMEM = {
	0x00, 0x00, 0x00, 0x00, 0x00, 0x00, 0x00, 0x00, 0x00, 0x00, 0x00, 0x00,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 0x00
};
// 'menu', 128x64px
const unsigned char myBitmapmenu [] PROGMEM = {
	0x00, 0x00, 0x00, 0x00, 0x00, 0x00, 0x00, 0x00, 0x00, 0x00, 0x00, 0x00,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 0x04
};
// 'bad_apple_img', 128x64px
const unsigned char epd_bitmap_bad_apple_img [] PROGMEM = {
	0xff, 0xff, 0xff, 0xff, 0xff, 0xff, 0xff, 0xff, 0xff, 0xff, 0xff, 0xff,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 0xff
};
// 'osu_logo', 128x64px
const unsigned char epd_bitmap_osu_logo [] PROGMEM = {
	0xff, 0xff, 0xff, 0xff, 0xff, 0xff, 0xff, 0xff, 0xff, 0xff, 0xff, 0xff,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 0xff
};

// 'firm_logo', 128x64px
const unsigned char epd_bitmap_firm_logo [] PROGMEM = {
	0x00, 0x00, 0x00, 0x00, 0x00, 0x00, 0x00, 0x00, 0x00, 0x00, 0x00, 0x00,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 0x00
};
// 'hoshino img', 128x64px
const unsigned char epd_bitmap_hoshino_img [] PROGMEM = {
	0xff, 0xff, 0xff, 0xff, 0xff, 0x7d, 0x80, 0xfe, 0xff, 0xff, 0xff, 0xff,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 0xff
};

// Array of all bitmaps for convenience. (Total bytes used to store images in PROGMEM = 1040)
const int epd_bitmap_allArray_LEN = 1;
const unsigned char* epd_bitmap_allArray[1] = {
	epd_bitmap_firm_logo
};

// 'firm_logo_small', 96x48
const unsigned char epd_bitmap_firm_logo_small [] PROGMEM = {
	0x00, 0x00, 0x00, 0x00, 0x00, 0x00, 0x00, 0x00, 0x00, 0x00, 0x00, 0x00,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 0x00
};


// Array of all bitmaps for convenience. (Total bytes used to store images in PROGMEM = 2080)
const int myBitmapallArray_LEN = 4;
const unsigned char* myBitmapallArray[myBitmapallArray_LEN] = {
	myBitmapdm_emiko,
	epd_bitmap_bad_apple_img,
	epd_bitmap_hoshino_img,
	epd_bitmap_osu_logo,
};

int backgroundNum = 0;

void setup(void) {
  u8g2.begin();
	Serial.begin(9600);
    // Khởi tạo nút bấm
  for (int i = 0; i < 4; i++) {
    pinMode(buttonPins[i], INPUT_PULLUP);  // Dùng internal pull-up
  }

	if (digitalRead(4) == LOW) {
		Serial.println("Config mode detected");
		configState = true;
	}

	u8g2.clearBuffer();
	EEPROM.get(0, backgroundNum);
	u8g2.drawXBMP(0, 0, 128, 64, epd_bitmap_firm_logo);
	u8g2.sendBuffer();
	delay(2000);
}

void loop(void) {
	int n1; int n2;
	EEPROM.get(0, n1);
	EEPROM.get(2, n2);
	if (n1 == -1) {
		EEPROM.put(0, 0);
	}
	if (n2 == -1) {
		EEPROM.put(2, 0);
	}
	while (configState) {
		setConfig();
	} 
	if (digitalRead(4) != LOW && updateScreen) {
		u8g2.clearBuffer();
		EEPROM.get(0, backgroundNum);
		u8g2.drawXBMP(0, 0, 128, 64, myBitmapallArray[backgroundNum]);
		u8g2.sendBuffer();
		updateScreen = false;
	}
	int osuKeyNum = 0;
	EEPROM.get(2, osuKeyNum);
  for (int i = 0; i < 4; i++) {
    int reading = digitalRead(buttonPins[i]);

    if (reading == LOW && !buttonState[i]) {
      // Nút được nhấn
      Keyboard.press(osukeys[osuKeyNum][i]);
      buttonState[i] = true;
      delay(10);
    } 
    else if (reading == HIGH && buttonState[i]) {
      // Nút được nhả
      Keyboard.release(osukeys[osuKeyNum][i]);
      buttonState[i] = false;
      delay(10);
    }
  }
}

void setConfig() {
	char* modes[] = {"","Background", "Modes", "Info", "Exit", ""};
	char* backgrounds[] = {"", "Dm Emiko Nin", "Bad Apple", "Hoshino", "osu! Logo", ""};
	char* moes[] = {"", "osu!", "osu! 2", "osu! mania", "osu! taiko", "osu! catch", ""};
	int mode = 1;
	bool needUpdate = true;
	bool backgroundMode = false;
	bool moeMode = false;
	int len = (sizeof(modes) / sizeof(modes[0])) - 2;

	while (true) {
		if (needUpdate) {
			u8g2.clearBuffer();

			u8g2.drawXBMP(0, 0, 128, 64, myBitmapmenu);
			u8g2.setFont(u8g2_font_7x13B_tr);

			u8g2.drawStr(0,10, modes[mode - 1]);
			u8g2.drawStr(20,35, modes[mode]);
			u8g2.drawStr(0,60, modes[mode + 1]);
			u8g2.sendBuffer();


			needUpdate = false;
		}
		if (digitalRead(6) == LOW && mode < len) {
			mode += 1;
			needUpdate = true;
			delay(100);
		}
		if (digitalRead(5) == LOW && mode > 1) {
			mode -= 1;
			needUpdate = true;
			delay(100);
		}
		if (digitalRead(7) == LOW) {
			if (backgroundMode) {
				EEPROM.put(0, mode - 1);
				u8g2.clearBuffer();
				u8g2.drawXBMP(0, 0, 128, 64, myBitmapallArray[mode - 1]);
				u8g2.sendBuffer();
				delay(2000);
				configState = true;
				delay(100);
				return;
			}
			if (moeMode) {
				EEPROM.put(2, mode - 1);
				configState = true;
				delay(100);
				return;
			}
			else {
				if (mode == 1) {
					for (int i = 0; i < (sizeof(backgrounds) / sizeof(backgrounds[0])); i++) {
						modes[i] = backgrounds[i];
					}
					mode = 1;
					needUpdate = true;
					backgroundMode = true;
					len = (sizeof(backgrounds) / sizeof(backgrounds[0])) - 2;
					delay(100);
				}
				if (mode == 2) {
					for (int i = 0; i < (sizeof(moes) / sizeof(moes[0])); i++) {
						modes[i] = moes[i];
					}
					mode = 1;
					needUpdate = true;
					moeMode = true;
					len = (sizeof(moes) / sizeof(moes[0])) - 2;
					delay(100);
				}
				if (mode == 3) {
					u8g2.clearBuffer();
					u8g2.drawXBMP(0, 0, 96, 48, epd_bitmap_firm_logo_small);
					u8g2.setFont(u8g2_font_5x7_tf);
					u8g2.drawStr(0, 48, "Made by BiaHaNoi");
					u8g2.drawStr(0, 57, "Inspired by DU ORIGIN");
					u8g2.sendBuffer();
					delay(3000);
					return;
				}
				if (mode == 4) {
					configState = false;
					return;
				}
			}
		}
	}
}
